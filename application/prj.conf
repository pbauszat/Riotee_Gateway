## west.yml
```
manifest:
  version: 0.9
 
  defaults:
    remote: zephyrproject
  remotes:
    - name: zephyrproject
      url-base: https://github.com/zephyrproject-rtos

  projects:
    - name: zephyr
      repo-path: zephyr
      revision: v3.3.0
      path: zephyr
      import:
        name-allowlist:
          - cmsis
          - hal_nordic
          - segger

  self:
    path: application
```

## prj.conf
```kconfig
CONFIG_EVENTS=y
CONFIG_USB_DEVICE_STACK=y
CONFIG_USB_DEVICE_PRODUCT="Riotee Gateway"
CONFIG_USB_DEVICE_PID=0x0001
CONFIG_USB_DRIVER_LOG_LEVEL_ERR=y
CONFIG_USB_DEVICE_LOG_LEVEL_ERR=y
CONFIG_USB_DEVICE_INITIALIZE_AT_BOOT=n

CONFIG_LOG=y
CONFIG_LOG_BACKEND_UART=y
CONFIG_SERIAL=y
CONFIG_UART_CONSOLE=y
CONFIG_UART_INTERRUPT_DRIVEN=y
CONFIG_UART_LINE_CTRL=y

CONFIG_STDOUT_CONSOLE=y
```

## src/main.c
```c
/*
 * Copyright (c) 2019 Intel Corporation
 *
 * SPDX-License-Identifier: Apache-2.0
 */

/**
 * @file
 * @brief Sample echo app for CDC ACM class
 *
 * Sample app for USB CDC ACM class driver. The received data is echoed back
 * to the serial port.
 */

#include <stdio.h>
#include <string.h>
#include <zephyr/device.h>
#include <zephyr/sys/base64.h>
#include <zephyr/drivers/gpio.h>
#include <zephyr/drivers/uart.h>
#include <zephyr/kernel.h>
#include <zephyr/sys/ring_buffer.h>

#include <zephyr/logging/log.h>
#include <zephyr/usb/usb_device.h>
#include <zephyr/usb/usbd.h>

#include "radio.h"

#define RING_BUF_SIZE 2048
#define PRINTER_STACK_SIZE 8192
#define CDCACM_STACK_SIZE 4096

LOG_MODULE_REGISTER(main, LOG_LEVEL_INF);

/* The devicetree node identifier for the "led0" alias. */
#define LED0_NODE DT_ALIAS(led0)

RING_BUF_DECLARE(cdcacm_ringbuf_tx, RING_BUF_SIZE);
RING_BUF_DECLARE(cdcacm_ringbuf_rx, RING_BUF_SIZE);

K_EVENT_DEFINE(uart_rx_evt);

static void interrupt_handler(const struct device *dev, void *user_data) {
  ARG_UNUSED(user_data);

  while (uart_irq_update(dev) && uart_irq_is_pending(dev)) {
    if (uart_irq_rx_ready(dev)) {
      int recv_len;
      uint8_t overflow_buffer[64];
      uint8_t *ring_buf_slice;

      /* Claim some space on the ringbuffer */
      uint32_t rb_size = ring_buf_put_claim(&cdcacm_ringbuf_rx, &ring_buf_slice, 64);
      if (rb_size > 0) {
        recv_len = uart_fifo_read(dev, ring_buf_slice, rb_size);
        ring_buf_put_finish(&cdcacm_ringbuf_rx, recv_len);
        k_event_set(&uart_rx_evt, 0xFFFFFFFF);

        /* If we can't allocate space on the ringbuffer, drop the UART data */
      } else {
        recv_len = uart_fifo_read(dev, overflow_buffer, 64);
        ring_buf_put_finish(&cdcacm_ringbuf_rx, 0);
        LOG_ERR("CDC Uart ringbuffer overflow");
      }

      if (recv_len < 0) {
        LOG_ERR("Failed to read UART FIFO");
      }
    }

    if (uart_irq_tx_ready(dev)) {
      uint8_t buffer[64];
      int rb_len, send_len;

      rb_len = ring_buf_get(&cdcacm_ringbuf_tx, buffer, sizeof(buffer));
      if (!rb_len) {
        LOG_DBG("Ring buffer empty, disable TX IRQ");
        uart_irq_tx_disable(dev);
        continue;
      }

      send_len = uart_fifo_fill(dev, buffer, rb_len);
      if (send_len < rb_len) {
        LOG_ERR("Drop %d bytes", rb_len - send_len);
      }

      LOG_DBG("ringbuf -> tty fifo %d bytes", send_len);
    }
  }
}

static int process_uart_pkt(pkt_t *dst, char *pkt_str, size_t n) {
  size_t n_written;
  unsigned int i = 0, j = 0;

  while (pkt_str[i] != ':') {
    if (++i == n)
      return -1;
  }

  if (base64_decode((uint8_t *)&dst->dev_id, 4, &n_written, pkt_str, i - j) < 0)
    return -1;
  j = ++i;

  while (pkt_str[i] != ':') {
    if (++i == n)
      return -1;
  }

  if (base64_decode((uint8_t *)&dst->pkt_id, 2, &n_written, pkt_str, i - j) < 0)
    return -1;
  j = ++i;

  while (pkt_str[i] != ':') {
    if (++i == n)
      return -1;
  }

  if (base64_decode((uint8_t *)&dst->acknowledgement_id, 2, &n_written, pkt_str, i - j) < 0)
    return -1;
  i++;

  if (base64_decode((uint8_t *)&dst->data, PKT_PAYLOAD_SIZE, &n_written, pkt_str, n - i) < 0)
    return -1;

  dst->len = 8 + n_written;
  return 0;
}

void cdcacm_handler(void) {
  const struct device *dev;

  int ret;

  ret = usb_enable(NULL);

  if (ret != 0) {
    LOG_ERR("Failed to enable USB");
    return;
  }

  dev = DEVICE_DT_GET_ONE(zephyr_cdc_acm_uart);
  if (!device_is_ready(dev)) {
    LOG_ERR("CDC ACM device not ready");
    return;
  }

  uart_irq_callback_set(dev, interrupt_handler);

  /* Enable rx interrupts */
  uart_irq_rx_enable(dev);

  if (!ring_buf_is_empty(&cdcacm_ringbuf_tx))
    uart_irq_tx_enable(dev);

  char pkt_string_buf[1024];
  unsigned int n_copied;
  char *ring_buf_slice;
  uint32_t rb_size;
  pkt_t pkt_buf;
  int rc;

  /* This means that no start of a packet has been found */
  int pkt_string_buf_idx = -1;

  while (1) {
    if ((rb_size = ring_buf_get_claim(&cdcacm_ringbuf_rx, (uint8_t **)&ring_buf_slice, 64)) == 0)
      k_event_wait(&uart_rx_evt, 0xFFFFFFFF, true, K_FOREVER);

    for (n_copied = 0; n_copied < rb_size; n_copied++) {
      /* If we have not detected the start of a packet yet */
      if (pkt_string_buf_idx < 0) {
        /* Check if this is the start of a packet*/
        if (ring_buf_slice[n_copied] == '[') {
          pkt_string_buf_idx = 0;
          LOG_INF("Start of packet detected");
        }
        continue;
      }

      /* Is this the end of a packet? */
      if (ring_buf_slice[n_copied] == ']') {
        if ((rc = process_uart_pkt(&pkt_buf, pkt_string_buf, pkt_string_buf_idx)) >= 0)
          LOG_DBG("Processed packet with %08X:%04X:%04X and %u byte payload", pkt_buf.dev_id, pkt_buf.pkt_id,
                  pkt_buf.acknowledgement_id, pkt_buf.len);
        else
          LOG_ERR("Processing failed with %d", rc);
        pkt_string_buf_idx = -1;
      } else {
        pkt_string_buf[pkt_string_buf_idx++] = ring_buf_slice[n_copied];
        if (pkt_string_buf_idx == sizeof(pkt_string_buf)) {
          LOG_ERR("Buffer is full, no packet detected");
          pkt_string_buf_idx = -1;
          break;
        }
      }
    }

    ring_buf_get_finish(&cdcacm_ringbuf_rx, n_copied);
  }
}

void printer_handler() {
  const struct device *dev;

  char pkt_descriptor[1024];

  pkt_t pkt_buf;
  dev = DEVICE_DT_GET_ONE(zephyr_cdc_acm_uart);
  if (!device_is_ready(dev)) {
    LOG_ERR("CDC ACM device not ready");
    return;
  }

  while (1) {
    /* Grab a packet from the queue */
    radio_msgq_get(&pkt_buf, K_FOREVER);

    if ((pkt_buf.len > (sizeof(pkt_t) - 1) || (pkt_buf.len < 8))) {
      /* Something is wrong with this packet! */
      LOG_ERR("Received packet with wrong size");
      continue;
    }

    size_t olen;
    size_t n_written = 0;
    pkt_descriptor[n_written++] = '[';

    base64_encode(pkt_descriptor + n_written, sizeof(pkt_descriptor), &olen, (uint8_t *)&pkt_buf.dev_id, 4);
    /* Make sure to also leave the trailing \0 in the string as a delimiter*/
    n_written += olen + 1;
    base64_encode(pkt_descriptor + n_written, sizeof(pkt_descriptor) - n_written, &olen, (uint8_t *)&pkt_buf.pkt_id, 2);
    n_written += olen + 1;
    base64_encode(pkt_descriptor + n_written, sizeof(pkt_descriptor) - n_written, &olen,
                  (uint8_t *)&pkt_buf.acknowledgement_id, 2);
    n_written += olen + 1;
    base64_encode(pkt_descriptor + n_written, sizeof(pkt_descriptor) - n_written, &olen, (uint8_t *)&pkt_buf.data,
                  pkt_buf.len - 8);
    n_written += olen + 1;
    pkt_descriptor[n_written++] = ']';

    if (ring_buf_space_get(&cdcacm_ringbuf_tx) >= n_written) {
      ring_buf_put(&cdcacm_ringbuf_tx, pkt_descriptor, n_written);
      uart_irq_tx_enable(dev);
    } else
      LOG_DBG("Dropped packet descriptor");

    LOG_DBG("[%08X:%04X:%04X(%u)]", pkt_buf.dev_id, pkt_buf.pkt_id, pkt_buf.acknowledgement_id, pkt_buf.len);
  }
}

void main(void) {
  int ret;

  const struct gpio_dt_spec led = GPIO_DT_SPEC_GET(LED0_NODE, gpios);

  if (!gpio_is_ready_dt(&led)) {
    return;
  }

  ret = gpio_pin_configure_dt(&led, GPIO_OUTPUT_ACTIVE);
  if (ret < 0) {
    return;
  }

  radio_init();
  radio_start();

  while (1) {
    ret = gpio_pin_toggle_dt(&led);
    k_msleep(100);
  }
}

K_THREAD_DEFINE(printer, PRINTER_STACK_SIZE, printer_handler, NULL, NULL, NULL, 7, 0, 0);
K_THREAD_DEFINE(cdcacm, CDCACM_STACK_SIZE, cdcacm_handler, NULL, NULL, NULL, 7, 0, 0);
```

## src/message_buffer.c
```c
#include <zephyr/sys/ring_buffer.h>

#include "message_buffer.h"
#include "radio.h"

#define MAX_NUM_DEVICES 16
#define PKTS_PER_BUF 16

typedef struct {
  /* ID of recipient for this message queue. This is set to own ID when slot is not used. */
  uint32_t dev_id;
  struct ring_buf msg_buf;
  uint8_t msg_buf_data[PKTS_PER_BUF * sizeof(pkt_t)];
} dev_msg_buf_t;

dev_msg_buf_t buffers[MAX_NUM_DEVICES];

#define msg_buf_used(idx) (buffers[idx].dev_id != my_dev_id)
#define msg_buf_set_unused(dev_msg_buf_ptr) dev_msg_buf_ptr->dev_id = my_dev_id

/* Get pointer to the dev_msg_buf for the specified device ID */
static inline dev_msg_buf_t *get_dev_msg_buf(uint32_t dev_id) {
  for (unsigned int buf_idx = 0; buf_idx < MAX_NUM_DEVICES; buf_idx++) {
    if (dev_id == buffers[buf_idx].dev_id)
      return &buffers[buf_idx];
  }
  return NULL;
}

static inline dev_msg_buf_t *get_empty_msg_buf() {
  for (unsigned int buf_idx = 0; buf_idx < MAX_NUM_DEVICES; buf_idx++) {
    if (!msg_buf_used(buf_idx))
      return &buffers[buf_idx];
  }
  return NULL;
}

int msg_buf_init(void) {
  for (unsigned int i = 0; i < MAX_NUM_DEVICES; i++) {
    ring_buf_init(&buffers[i].msg_buf, PKTS_PER_BUF * sizeof(pkt_t), buffers[i].msg_buf_data);
    /* Set to own ID to indicate that this slot is not used */
    buffers[i].dev_id = my_dev_id;
  }
  return 0;
}

int msg_buf_insert(pkt_t *pkt) {
  dev_msg_buf_t *dev_msg_buf;

  /* Search for a buffer that is already in use for this device id */
  if ((dev_msg_buf = get_dev_msg_buf(pkt->dev_id)) == NULL) {
    /* No buffer in use? Get a new one. */
    if ((dev_msg_buf = get_empty_msg_buf()) == NULL)
      /* All buffers used*/
      return -1;
    /* Claim the empty buffer for this device id */
    dev_msg_buf->dev_id = pkt->dev_id;
  }

  /* Insert own device ID as sender into the packet */
  pkt->dev_id = my_dev_id;

  ring_buf_put(&dev_msg_buf->msg_buf, (uint8_t *)pkt, sizeof(pkt_t));
  return 0;
}

/* This gets called from a critical section within the radio ISR and should run as quickly as possible */
int msg_buf_get_claim(pkt_t **dst, uint32_t dev_id) {
  dev_msg_buf_t *dev_msg_buf;
  if ((dev_msg_buf = get_dev_msg_buf(dev_id)) == NULL)
    /* No messages available for this device id*/
    return 1;

  if (sizeof(pkt_t) != ring_buf_get_claim(&dev_msg_buf->msg_buf, (uint8_t **)dst, sizeof(pkt_t)))
    return -1;

  return 0;
}

int msg_buf_get_finish(uint32_t dev_id) {
  dev_msg_buf_t *dev_msg_buf;
  if ((dev_msg_buf = get_dev_msg_buf(dev_id)) == NULL)
    /* This should not happen, since we should have claimed before */
    return -1;

  ring_buf_get_finish(&dev_msg_buf->msg_buf, sizeof(pkt_t));

  if (ring_buf_is_empty(&dev_msg_buf->msg_buf))
    msg_buf_set_unused(dev_msg_buf);

  return 0;
}
```

## src/message_buffer.h
```c
#ifndef __MESSAGE_BUFFER_H_
#define __MESSAGE_BUFFER_H_

#include "radio.h"
#include <stdint.h>

#define MSG_PAYLOAD_SIZE 247

typedef struct {
  uint8_t len;
  uint16_t pkt_id;
} msg_header_t;

typedef struct {
  msg_header_t header;
  uint8_t data[MSG_PAYLOAD_SIZE];
} msg_t;

int msg_buf_init(void);
int msg_buf_insert(uint32_t dev_id, msg_t *msg);

int msg_buf_get(msg_header_t *hdr_dst, uint8_t *data_dst, uint32_t dev_id);

#endif /* __MESSAGE_BUFFER_H_ */
```

## src/radio.c
```c
#include <nrf.h>
#include <stdio.h>
#include <string.h>

#include <zephyr/device.h>
#include <zephyr/drivers/gpio.h>

#include <zephyr/kernel.h>

#include "message_buffer.h"

#define PKT_MQ_CAPACITY 16
#define RADIO_STACK_SIZE 1024

K_MSGQ_DEFINE(pkt_mq, sizeof(pkt_t), PKT_MQ_CAPACITY, 4);

/* Structure for the radio handler thread that fills the pkt_mq */
K_THREAD_STACK_DEFINE(radio_thread_stack, RADIO_STACK_SIZE);
struct k_thread radio_thread_data;

/* Stores the device ID of the gateway */
uint32_t my_dev_id;

/* DMA buffer for incoming radio packets */
static pkt_t rx_pkt;

/* Buffer for outgoing acknowledgement packets in case no other packets are to be sent */
static pkt_t ack_only_pkt;

enum {
  /* Uplink logical address index */
  LA_UPLINK_IDX = 1,
  /* Downlink logical address index */
  LA_DOWNLINK_IDX = 2,
};

enum {
  /* Uplink logical address index */
  LA_UPLINK = 0x5D,
  /* Downlink logical address index */
  LA_DOWNLINK = 0xF7,
};

/* Used to signal from the radio ISR to the handler thread */
enum {
  RADIO_EVT_CRCOK = (1UL << 0),
  RADIO_EVT_CLAIM = (1UL << 1),
  RADIO_EVT_END = (1UL << 2),
};

K_EVENT_DEFINE(radio_evt);

static void radio_isr(void);

int radio_init() {
  /* 0dBm TX power */
  NRF_RADIO->TXPOWER = (RADIO_TXPOWER_TXPOWER_0dBm << RADIO_TXPOWER_TXPOWER_Pos);
  /* 2450 MHz frequency */
  NRF_RADIO->FREQUENCY = 76UL;
  /* BLE 2MBit */
  NRF_RADIO->MODE = (RADIO_MODE_MODE_Ble_1Mbit << RADIO_MODE_MODE_Pos);
  /* Fast radio rampup */
  NRF_RADIO->MODECNF0 = (RADIO_MODECNF0_RU_Fast << RADIO_MODECNF0_RU_Pos);

  /* We'll only use base address 1, i.e. logical addresses 1-7 */
  NRF_RADIO->BASE1 = 0xFB235D41;

  NRF_RADIO->PREFIX0 = (LA_DOWNLINK << 16) | (LA_UPLINK << 8);
  /* We want to receive on both, downlink and uplink message addresses */
  NRF_RADIO->RXADDRESSES = (1UL << LA_UPLINK_IDX);

  /* Make interframe spacing slightly longer than turnaround time (~40us) */
  NRF_RADIO->TIFS = 60;

  /* No S0, LEN and S1 fields */
  NRF_RADIO->PCNF0 = (0 << RADIO_PCNF0_S1LEN_Pos) | (0 << RADIO_PCNF0_S0LEN_Pos) | (8 << RADIO_PCNF0_LFLEN_Pos) |
                     (RADIO_PCNF0_PLEN_8bit << RADIO_PCNF0_PLEN_Pos);

  /* No whitening, little endian, 2B base address, 4B payload */
  NRF_RADIO->PCNF1 = (RADIO_PCNF1_WHITEEN_Disabled << RADIO_PCNF1_WHITEEN_Pos) |
                     (RADIO_PCNF1_ENDIAN_Little << RADIO_PCNF1_ENDIAN_Pos) | (2 << RADIO_PCNF1_BALEN_Pos) |
                     (0 << RADIO_PCNF1_STATLEN_Pos) | (255 << RADIO_PCNF1_MAXLEN_Pos);

  /* One byte CRC */
  NRF_RADIO->CRCCNF = (RADIO_CRCCNF_LEN_Three << RADIO_CRCCNF_LEN_Pos);
  NRF_RADIO->CRCINIT = 0xABUL;
  NRF_RADIO->CRCPOLY = 0x108UL;

  NRF_RADIO->TXADDRESS = LA_DOWNLINK_IDX;

  /* Set default shorts */
  NRF_RADIO->SHORTS = RADIO_SHORTS_READY_START_Msk | RADIO_SHORTS_END_DISABLE_Msk;

  NRF_RADIO->INTENCLR = 0xFFFFFFFF;

  IRQ_DIRECT_CONNECT(RADIO_IRQn, 0, radio_isr, 0);
  irq_enable(RADIO_IRQn);

  /* Device ID of the gateway */
  my_dev_id = NRF_FICR->DEVICEID[0];

  /* Prepare empty acknowledgement packet */
  ack_only_pkt.len = 8;
  ack_only_pkt.pkt_id = 0xFFFF;
  ack_only_pkt.dev_id = my_dev_id;

  return 0;
}

static void radio_isr(void) {
  if ((NRF_RADIO->EVENTS_TXREADY == 1) && (NRF_RADIO->INTENSET & RADIO_INTENSET_TXREADY_Msk)) {
    NRF_RADIO->EVENTS_TXREADY = 0;

    /* Set shorts for turning around to RX */
    NRF_RADIO->SHORTS &= ~RADIO_SHORTS_DISABLED_TXEN_Msk;
    NRF_RADIO->SHORTS |= RADIO_SHORTS_DISABLED_RXEN_Msk;

    NRF_RADIO->INTENCLR = 0xFFFFFFFF;
    NRF_RADIO->INTENSET = RADIO_INTENSET_END_Msk;
  }
  if ((NRF_RADIO->EVENTS_RXREADY == 1) && (NRF_RADIO->INTENSET & RADIO_INTENSET_RXREADY_Msk)) {
    NRF_RADIO->EVENTS_RXREADY = 0;

    /* Set shorts for turning around to TX to send acknowledgement */
    NRF_RADIO->SHORTS &= ~RADIO_SHORTS_DISABLED_RXEN_Msk;
    NRF_RADIO->SHORTS |= RADIO_SHORTS_DISABLED_TXEN_Msk;
    NRF_RADIO->INTENCLR = 0xFFFFFFFF;
    NRF_RADIO->INTENSET = RADIO_INTENSET_CRCOK_Msk | RADIO_INTENSET_CRCERROR_Msk;
  }
  /* Transmission of acknowledgement has finished */
  if ((NRF_RADIO->EVENTS_END == 1) && (NRF_RADIO->INTENSET & RADIO_INTENSET_END_Msk)) {
    NRF_RADIO->EVENTS_END = 0;

    /* Prepare for listening again */
    NRF_RADIO->PACKETPTR = (uint32_t)&rx_pkt;
    NRF_RADIO->INTENCLR = 0xFFFFFFFF;
    NRF_RADIO->INTENSET = RADIO_INTENSET_RXREADY_Msk;

    /* Notify application that it can pick up the received packet */
    k_event_post(&radio_evt, RADIO_EVT_END);
  }
  /* Valid packet received */
  if ((NRF_RADIO->EVENTS_CRCOK == 1) && (NRF_RADIO->INTENSET & RADIO_INTENSET_CRCOK_Msk)) {
    NRF_RADIO->EVENTS_CRCOK = 0;

    pkt_t* tx_pkt;
    /* Get a packet that is to be sent to the device from which we just received something */
    if (msg_buf_get_claim(&tx_pkt, rx_pkt.dev_id) == 0)
      /* Let the application know that we have claimed a buffer */
      k_event_post(&radio_evt, RADIO_EVT_CLAIM);
    else
      /* If there is no packet pending, send an empty acknowledgement */
      tx_pkt = &ack_only_pkt;

    /* Insert Packet ID of received packet into acknowledgement */
    tx_pkt->acknowledgement_id = rx_pkt.pkt_id;

    NRF_RADIO->PACKETPTR = (uint32_t)tx_pkt;

    NRF_RADIO->INTENCLR = 0xFFFFFFFF;
    NRF_RADIO->INTENSET = RADIO_INTENSET_TXREADY_Msk;

    /* Notify application that it can pick up the received packet */
    k_event_post(&radio_evt, RADIO_EVT_CRCOK);
  }
  /* Bad CRC -> Abort transmission of Acknowledgement*/
  if ((NRF_RADIO->EVENTS_CRCERROR == 1) && (NRF_RADIO->INTENSET & RADIO_INTENSET_CRCERROR_Msk)) {
    NRF_RADIO->EVENTS_CRCERROR = 0;

    /* Set shorts for turning around to RX */
    NRF_RADIO->SHORTS &= ~RADIO_SHORTS_DISABLED_TXEN_Msk;
    NRF_RADIO->SHORTS |= RADIO_SHORTS_DISABLED_RXEN_Msk;

    /* Disable radio to start listening again */
    NRF_RADIO->TASKS_DISABLE = 1;

    NRF_RADIO->INTENCLR = 0xFFFFFFFF;
    NRF_RADIO->INTENSET = RADIO_INTENSET_RXREADY_Msk;
  }
}

/* This thread processes the radio events to offload work from the ISR. */
static void radio_handler() {
  pkt_t tmp_buf;
  while (1) {
    /* Wait until a valid packet is received */
    k_event_wait(&radio_evt, RADIO_EVT_CRCOK, false, K_FOREVER);
    /* Copy received packet into buffer to immediately free the receive buffer */
    memcpy(&tmp_buf, &rx_pkt, rx_pkt.len + 1);

    /* Wait until acknowledgement has been sent */
    uint32_t events = k_event_wait(&radio_evt, RADIO_EVT_END, false, K_FOREVER);

    /* If the acknowledgement packet has been taken from the message buffer*/
    if (events & RADIO_EVT_CLAIM)
      /* Tell the buffer that we're done with the packet */
      msg_buf_get_finish(tmp_buf.dev_id);

    /* Send last received packet to application for processing */
    k_msgq_put(&pkt_mq, &tmp_buf, K_NO_WAIT);

    k_event_clear(&radio_evt, 0xFFFFFFFF);
  }
}

int radio_msgq_get(pkt_t* pkt, k_timeout_t timeout) {
  return k_msgq_get(&pkt_mq, pkt, timeout);
}

int radio_start() {
  k_thread_create(&radio_thread_data, radio_thread_stack, K_THREAD_STACK_SIZEOF(radio_thread_stack), radio_handler,
                  NULL, NULL, NULL, 6, 0, K_NO_WAIT);

  /* If it's not running, start the HFCLCK */
  if ((NRF_CLOCK->HFCLKSTAT & (CLOCK_HFCLKSTAT_SRC_Xtal << CLOCK_HFCLKSTAT_SRC_Pos)) == 0) {
    NRF_CLOCK->EVENTS_HFCLKSTARTED = 0;

    NRF_CLOCK->TASKS_HFCLKSTART = 1;

    while (NRF_CLOCK->EVENTS_HFCLKSTARTED == 0) {
    };
    NRF_CLOCK->EVENTS_HFCLKSTARTED = 0;
  }

  NRF_RADIO->PACKETPTR = (uint32_t)&rx_pkt;
  NRF_RADIO->INTENSET = RADIO_INTENSET_RXREADY_Msk;
  NRF_RADIO->TASKS_RXEN = 1;

  return 0;
}
```

## src/radio.h
```c
#ifndef __RADIO_H_
#define __RADIO_H_

int radio_init();
int radio_start();

/* Max payload size is 255. We have 8 Byte protocol overhead. */
#define PKT_PAYLOAD_SIZE 247

typedef struct __attribute__((packed)) {
  uint8_t len;
  uint32_t dev_id;
  uint16_t pkt_id;
  uint16_t acknowledgement_id;
  uint8_t data[PKT_PAYLOAD_SIZE];
} pkt_t;

int radio_msgq_get(pkt_t* pkt, k_timeout_t timeout);

extern uint32_t my_dev_id;

#endif /* __RADIO_H_ */
```
