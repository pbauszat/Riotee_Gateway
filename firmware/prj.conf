## CMakeLists.txt
```
cmake_minimum_required(VERSION 3.20.0)

set(BOARD nrf52840dongle_nrf52840)
find_package(Zephyr REQUIRED HINTS $ENV{ZEPHYR_BASE})
project(riotee_gateway)


FILE(GLOB app_sources src/*.c)
target_sources(app PRIVATE ${app_sources})
```

## west.yml
```
manifest:
  version: 0.9
 
  defaults:
    remote: zephyrproject
  remotes:
    - name: zephyrproject
      url-base: https://github.com/zephyrproject-rtos

  projects:
    - name: zephyr
      repo-path: zephyr
      revision: v3.4.0
      path: zephyr
      import:
        name-allowlist:
          - cmsis
          - hal_nordic
          - segger

  self:
    path: firmware
```

## prj.conf
```kconfig
CONFIG_EVENTS=y
CONFIG_USB_DEVICE_STACK=y
CONFIG_USB_DEVICE_MANUFACTURER="Nessie Circuits"
CONFIG_USB_DEVICE_PRODUCT="Riotee Gateway"
CONFIG_USB_DEVICE_PID=0xC8A2
CONFIG_USB_DEVICE_VID=0x1209
CONFIG_USB_DEVICE_INITIALIZE_AT_BOOT=y


CONFIG_LOG=y
CONFIG_LOG_BACKEND_UART=y
CONFIG_SERIAL=y
CONFIG_UART_CONSOLE=y
CONFIG_UART_INTERRUPT_DRIVEN=y
CONFIG_UART_LINE_CTRL=y

CONFIG_STDOUT_CONSOLE=y
```

## app.overlay
```dts
zephyr_udc0: &usbd {
	compatible = "nordic,nrf-usbd";
	status = "okay";

	cdc_acm_uart: cdc_acm_uart {
		compatible = "zephyr,cdc-acm-uart";
	};
};

/ {
	chosen{
		zephyr,console = &uart0;
		zephyr,shell-uart = &uart0;
		zephyr,uart-mcumgr = &uart0;
		zephyr,bt-mon-uart = &uart0;
		zephyr,bt-c2h-uart = &uart0;
	};
};
```

## src/main.c
```c
#include <stdio.h>
#include <string.h>
#include <zephyr/device.h>
#include <zephyr/drivers/gpio.h>
#include <zephyr/drivers/uart.h>
#include <zephyr/kernel.h>
#include <zephyr/sys/ring_buffer.h>

#include <zephyr/logging/log.h>
#include <zephyr/usb/usb_device.h>
#include <zephyr/usb/usbd.h>

#include "base64.h"
#include "radio.h"
#include "message_buffer.h"

#define RING_BUF_SIZE 2048
#define PRINTER_STACK_SIZE 2048
#define CDCACM_STACK_SIZE 2048

LOG_MODULE_REGISTER(main, LOG_LEVEL_INF);

/* The devicetree node identifier for the "led0" alias. */
#define LED0_NODE DT_ALIAS(led0)

RING_BUF_DECLARE(cdcacm_ringbuf_tx, RING_BUF_SIZE);
RING_BUF_DECLARE(cdcacm_ringbuf_rx, RING_BUF_SIZE);

K_EVENT_DEFINE(uart_rx_evt);

static void interrupt_handler(const struct device *dev, void *user_data) {
  ARG_UNUSED(user_data);

  while (uart_irq_update(dev) && uart_irq_is_pending(dev)) {
    if (uart_irq_rx_ready(dev)) {
      int recv_len;
      uint8_t buffer[64];

      /* Claim some space on the ringbuffer */
      recv_len = uart_fifo_read(dev, buffer, sizeof(buffer));
      if (recv_len < 0) {
        LOG_ERR("Failed to read UART FIFO");
        continue;
      }
      uint32_t written = ring_buf_put(&cdcacm_ringbuf_rx, buffer, recv_len);
      if (written > 0)
        k_event_set(&uart_rx_evt, 0xFFFFFFFF);
      else
        LOG_ERR("UART ringbuffer full");
    }

    if (uart_irq_tx_ready(dev)) {
      uint8_t buffer[64];
      int rb_len, send_len;

      rb_len = ring_buf_get(&cdcacm_ringbuf_tx, buffer, sizeof(buffer));
      if (!rb_len) {
        LOG_DBG("Ring buffer empty, disable TX IRQ");
        uart_irq_tx_disable(dev);
        continue;
      }

      send_len = uart_fifo_fill(dev, buffer, rb_len);
      if (send_len < rb_len) {
        LOG_ERR("Drop %d bytes", rb_len - send_len);
      }

      LOG_DBG("ringbuf -> tty fifo %d bytes", send_len);
    }
  }
}

static int string2packet(pkt_t *dst, char *pkt_str, size_t pkt_str_len) {
  int n_written;
  size_t n;
  char *s = pkt_str;

  if ((n = strlen(s)) != 8)
    return -1;

  if (base64_decode((uint8_t *)&dst->hdr.dev_id, 4, s, n) < 0)
    return -1;

  s += n + 1;
  if ((n = strlen(s)) != 4)
    return -1;

  if (base64_decode((uint8_t *)&dst->hdr.pkt_id, 2, s, n) < 0)
    return -1;

  s += n + 1;
  if ((s - pkt_str) > pkt_str_len)
    return -1;
  n = strlen(s);

  if ((n_written = base64_decode((uint8_t *)&dst->data, PKT_PAYLOAD_SIZE, s, n)) < 0)
    return -1;

  dst->len = sizeof(pkt_header_t) + n_written;
  return 0;
}

static int packet2string(char *dst, size_t dst_size, pkt_t *pkt) {
  int olen;
  int n_written = 0;

  int64_t timestamp = k_uptime_get();

  dst[n_written++] = '[';
  if ((olen = base64_encode(dst + n_written, dst_size, (uint8_t *)&pkt->hdr.dev_id, 4)) < 0)
    return -1;

  /* Make sure to also include the trailing \0 in the string as a delimiter*/
  n_written += olen + 1;
  if ((olen = base64_encode(dst + n_written, dst_size - n_written, (uint8_t *)&pkt->hdr.pkt_id, 2)) < 0)
    return -1;

  n_written += olen + 1;
  if ((olen = base64_encode(dst + n_written, dst_size - n_written, (uint8_t *)&pkt->hdr.ack_id, 2)) < 0)
    return -1;

  n_written += olen + 1;
  if ((olen = base64_encode(dst + n_written, dst_size - n_written, (uint8_t *)&timestamp, 8)) < 0)
    return -1;

  n_written += olen + 1;
  if ((olen = base64_encode(dst + n_written, dst_size - n_written, (uint8_t *)&pkt->data,
                            pkt->len - sizeof(pkt_header_t))) < 0)
    return -1;

  n_written += olen + 1;
  dst[n_written++] = ']';
  return n_written;
}

/* Reads data from the CDC ACM RX ringbuffer into dst until the specified character is found. */
static int ring_buf_read_until(char *dst, size_t size_dst, char c) {
  char *buf_slice_p;
  int n_to_copy;
  char *rc_find;
  char *p = dst;
  int rb_size;

  do {
    /* Wait for a slice from the CDC ACM RX ringbuffer, blocking on the associated event */
    while ((rb_size = ring_buf_get_claim(&cdcacm_ringbuf_rx, (uint8_t **)&buf_slice_p, 64)) == 0)
      k_event_wait(&uart_rx_evt, 0xFFFFFFFF, true, K_FOREVER);

    if ((rc_find = memchr(buf_slice_p, c, rb_size)) == NULL)
      n_to_copy = rb_size;
    else
      n_to_copy = rc_find - buf_slice_p + 1;

    /* Check if the buffer would overflow */
    if ((p + n_to_copy) >= (dst + size_dst))
      return -1;
    memcpy(p, buf_slice_p, n_to_copy);
    /* Tell the ringbuffer how many bytes we've consumed */
    ring_buf_get_finish(&cdcacm_ringbuf_rx, n_to_copy);
    p += n_to_copy;
  } while (rc_find == NULL);
  return p - dst;
}

int cdcacm_init(void) {
  const struct device *dev;
  uint32_t dtr;

  dev = DEVICE_DT_GET_ONE(zephyr_cdc_acm_uart);
  if (!device_is_ready(dev)) {
    LOG_ERR("CDC ACM device not ready");
    return -1;
  }

  LOG_INF("Wait for DTR");

  while (true) {
    uart_line_ctrl_get(dev, UART_LINE_CTRL_DTR, &dtr);
    if (dtr) {
      break;
    } else {
      k_msleep(10);
    }
  }

  LOG_INF("DTR set");

  uart_irq_callback_set(dev, interrupt_handler);

  /* Enable rx interrupts */
  uart_irq_rx_enable(dev);

  if (!ring_buf_is_empty(&cdcacm_ringbuf_tx))
    uart_irq_tx_enable(dev);
  return 0;
}

/* Receives incoming data stream from cdc acm, extracts packets and processes the result */
void cdcacm_handler(void) {
  static char pkt_string_buf[512];

  pkt_t pkt;
  int rc;
  int pkt_str_len;
  while (1) {
    /* Search for start of packet */
    if ((pkt_str_len = ring_buf_read_until(pkt_string_buf, sizeof(pkt_string_buf), '[')) < 0)
      continue;

    /* Search for end of packet */
    if ((pkt_str_len = ring_buf_read_until(pkt_string_buf, sizeof(pkt_string_buf), ']')) < 0)
      continue;

    /* pkt_string_buf contains packet string plus closing bracket */
    if ((rc = string2packet(&pkt, pkt_string_buf, pkt_str_len - 1)) < 0) {
      LOG_ERR("Error processing packet: %d", rc);
      continue;
    }
    LOG_DBG("Packet processed: %08X, %04X", pkt.hdr.dev_id, pkt.hdr.pkt_id);
    msg_buf_insert(&pkt);
  }
}

/* Receives packets from the radio packet queue, generates a base64 based string and hands it over to the CDC ACM*/
void printer_handler() {
  const struct device *dev;
  static char pkt_descriptor[512];

  pkt_t pkt_buf;
  int n;

  dev = DEVICE_DT_GET_ONE(zephyr_cdc_acm_uart);
  if (!device_is_ready(dev)) {
    LOG_ERR("CDC ACM device not ready");
    return;
  }

  while (1) {
    /* Grab a packet from the queue */
    radio_msgq_get(&pkt_buf, K_FOREVER);

    if ((pkt_buf.len > (sizeof(pkt_t) - 1) || (pkt_buf.len < 8))) {
      LOG_ERR("Received packet with wrong size");
      continue;
    }

    if ((n = packet2string(pkt_descriptor, sizeof(pkt_descriptor), &pkt_buf)) < 0) {
      LOG_ERR("Error encoding packet");
      continue;
    }

    if (ring_buf_space_get(&cdcacm_ringbuf_tx) >= n) {
      ring_buf_put(&cdcacm_ringbuf_tx, pkt_descriptor, n);
      uart_irq_tx_enable(dev);
    } else
      LOG_DBG("Ringbuf full. Dropping packet descriptor.");

    LOG_INF("[%08X:%04X:%04X(%u)]", pkt_buf.hdr.dev_id, pkt_buf.hdr.pkt_id, pkt_buf.hdr.ack_id, pkt_buf.len);
  }
}

void blinky_thread() {
  int ret;
  const struct gpio_dt_spec led = GPIO_DT_SPEC_GET(LED0_NODE, gpios);

  if (!gpio_is_ready_dt(&led)) {
    return;
  }

  ret = gpio_pin_configure_dt(&led, GPIO_OUTPUT_ACTIVE);
  if (ret < 0) {
    return;
  }

  while (1) {
    ret = gpio_pin_toggle_dt(&led);
    k_msleep(1000);
  }
}

int main(void) {
  cdcacm_init();

  msg_buf_init();
  radio_init();
  radio_start();

  return 0;
}

K_THREAD_DEFINE(printer, PRINTER_STACK_SIZE, printer_handler, NULL, NULL, NULL, 2, 0, 0);
K_THREAD_DEFINE(cdcacm, CDCACM_STACK_SIZE, cdcacm_handler, NULL, NULL, NULL, 2, 0, 0);
K_THREAD_DEFINE(blinky, CDCACM_STACK_SIZE, blinky_thread, NULL, NULL, NULL, 3, 0, 0);
```

## src/base64.c
```c
#include <stdio.h>
#include <string.h>

static const char base64_table[] = "ABCDEFGHIJKLMNOPQRSTUVWXYZabcdefghijklmnopqrstuvwxyz0123456789-_";

int base64_encode(char *output, size_t output_size, unsigned char *input, size_t length) {
  int i, j;
  int padding = 0;

  size_t encoded_length = (length + 2) / 3 * 4;  // Calculate the encoded length

  if (output_size < encoded_length + 1)  // Check if output buffer is large enough
    return -1;

  for (i = 0, j = 0; i < length; i += 3) {
    unsigned char a = input[i];
    unsigned char b = (i + 1 < length) ? input[i + 1] : 0;
    unsigned char c = (i + 2 < length) ? input[i + 2] : 0;

    output[j++] = base64_table[a >> 2];
    output[j++] = base64_table[((a & 0x03) << 4) | (b >> 4)];
    output[j++] = base64_table[((b & 0x0F) << 2) | (c >> 6)];
    output[j++] = base64_table[c & 0x3F];
  }

  // Add padding characters if necessary
  if (length % 3 == 1) {
    output[j - 2] = '=';
    output[j - 1] = '=';
    padding = 2;
  } else if (length % 3 == 2) {
    output[j - 1] = '=';
    padding = 1;
  }

  output[j] = '\0';  // Null-terminate the string

  return j;
}

int base64_decode(unsigned char *output, size_t output_size, char *input, size_t length) {
  int i, j;
  int padding = 0;

  size_t decoded_length = (length * 3) / 4;  // Calculate the maximum decoded length

  if (input[length - 1] == '=') {
    padding++;
    if (input[length - 2] == '=')
      padding++;
  }

  if (output_size < (decoded_length - padding))
    return -1;

  for (i = 0, j = 0; i < length; i += 4) {
    unsigned char a = strchr(base64_table, input[i]) - base64_table;
    unsigned char b = strchr(base64_table, input[i + 1]) - base64_table;
    unsigned char c = strchr(base64_table, input[i + 2]) - base64_table;
    unsigned char d = strchr(base64_table, input[i + 3]) - base64_table;

    output[j++] = (a << 2) | (b >> 4);
    if (input[i + 2] != '=')
      output[j++] = (b << 4) | (c >> 2);
    if (input[i + 3] != '=')
      output[j++] = (c << 6) | d;
  }

  return j;
}
```

## src/base64.h
```c
#include <stddef.h>

/* URL-safe base64 encode */
int base64_encode(char *output, size_t output_size, unsigned char *input, size_t length);
/* URL-safe base64 decode */
int base64_decode(unsigned char *output, size_t output_size, char *input, size_t length);
```

## src/message_buffer.c
```c
#include <zephyr/sys/ring_buffer.h>
#include <zephyr/logging/log.h>
#include <zephyr/device.h>

#include "message_buffer.h"
#include "radio.h"

LOG_MODULE_REGISTER(message_buffer, LOG_LEVEL_INF);

#define MAX_NUM_DEVICES 16
#define PKTS_PER_BUF 16

typedef struct {
  bool in_use;
  /* ID of recipient for this message queue. */
  uint32_t dev_id;
  struct ring_buf msg_buf;
  uint8_t msg_buf_data[PKTS_PER_BUF * sizeof(pkt_t)];
} dev_msg_buf_t;

dev_msg_buf_t buffers[MAX_NUM_DEVICES];

/* Get pointer to the dev_msg_buf for the specified device ID */
static inline dev_msg_buf_t *get_dev_msg_buf(uint32_t dev_id) {
  for (unsigned int buf_idx = 0; buf_idx < MAX_NUM_DEVICES; buf_idx++) {
    if (buffers[buf_idx].in_use && (dev_id == buffers[buf_idx].dev_id))
      return &buffers[buf_idx];
  }
  return NULL;
}

static inline dev_msg_buf_t *get_empty_msg_buf() {
  for (unsigned int buf_idx = 0; buf_idx < MAX_NUM_DEVICES; buf_idx++) {
    if (!buffers[buf_idx].in_use)
      return &buffers[buf_idx];
  }
  return NULL;
}

int msg_buf_init(void) {
  for (unsigned int i = 0; i < MAX_NUM_DEVICES; i++) {
    ring_buf_init(&buffers[i].msg_buf, PKTS_PER_BUF * sizeof(pkt_t), buffers[i].msg_buf_data);
    buffers[i].in_use = false;
  }
  return 0;
}

int msg_buf_insert(pkt_t *pkt) {
  dev_msg_buf_t *dev_msg_buf;

  /* Search for a buffer that is already in use for this device id */
  if ((dev_msg_buf = get_dev_msg_buf(pkt->hdr.dev_id)) == NULL) {
    /* No buffer in use? Get a new one. */
    if ((dev_msg_buf = get_empty_msg_buf()) == NULL)
      /* All buffers used*/
      return -1;
    /* Claim the empty buffer for this device id */
    dev_msg_buf->dev_id = pkt->hdr.dev_id;
  }

  LOG_DBG("Adding packet for 0x%08X to message buffer", dev_msg_buf->dev_id);
  ring_buf_put(&dev_msg_buf->msg_buf, (uint8_t *)pkt, sizeof(pkt_t));
  dev_msg_buf->in_use = true;

  return 0;
}

/* This gets called from a critical section within the radio ISR and should run as quickly as possible */
int msg_buf_get_claim(pkt_t **dst, uint32_t dev_id) {
  dev_msg_buf_t *dev_msg_buf;
  size_t rb_size;
  if ((dev_msg_buf = get_dev_msg_buf(dev_id)) == NULL)
    /* No messages available for this device id*/
    return 1;

  if ((rb_size = ring_buf_get_claim(&dev_msg_buf->msg_buf, (uint8_t **)dst, sizeof(pkt_t))) != sizeof(pkt_t)) {
    /* This shouldn't happen*/
    return -1;
  }

  return 0;
}

int msg_buf_get_finish(uint32_t dev_id) {
  dev_msg_buf_t *dev_msg_buf;

  if ((dev_msg_buf = get_dev_msg_buf(dev_id)) == NULL)
    /* This should not happen, since we should have claimed before */
    return -1;

  ring_buf_get_finish(&dev_msg_buf->msg_buf, sizeof(pkt_t));

  if (ring_buf_is_empty(&dev_msg_buf->msg_buf))
    dev_msg_buf->in_use = false;
  LOG_DBG("Retrieved packet for 0x%08X from message buffer", dev_msg_buf->dev_id);

  return 0;
}
```

## src/message_buffer.h
```c
#ifndef __MESSAGE_BUFFER_H_
#define __MESSAGE_BUFFER_H_

#include "radio.h"
#include <stdint.h>

#define MSG_PAYLOAD_SIZE 247

typedef struct {
  uint8_t len;
  uint16_t pkt_id;
} msg_header_t;

typedef struct {
  msg_header_t header;
  uint8_t data[MSG_PAYLOAD_SIZE];
} msg_t;

int msg_buf_init(void);
int msg_buf_insert(pkt_t *pkt);

/* Get a pointer to a packet for the device from the message buffer */
int msg_buf_get_claim(pkt_t **dst, uint32_t dev_id);
/* Let message buffer know that the packet was processed */
int msg_buf_get_finish(uint32_t dev_id);

#endif /* __MESSAGE_BUFFER_H_ */
```

## src/radio.c
```c
#include <nrf.h>
#include <stdio.h>
#include <string.h>

#include <zephyr/device.h>
#include <zephyr/drivers/gpio.h>

#include <zephyr/kernel.h>

#include "message_buffer.h"

#define PKT_MQ_CAPACITY 16
#define RADIO_STACK_SIZE 1024

K_MSGQ_DEFINE(pkt_mq, sizeof(pkt_t), PKT_MQ_CAPACITY, 4);

/* Structure for the radio handler thread that fills the pkt_mq */
K_THREAD_STACK_DEFINE(radio_thread_stack, RADIO_STACK_SIZE);
struct k_thread radio_thread_data;

/* DMA buffer for incoming radio packets */
static pkt_t rx_pkt;

/* Buffer for outgoing acknowledgement packets in case no other packets are to be sent */
static pkt_t ack_only_pkt;

enum {
  /* Uplink logical address index */
  LA_UPLINK_IDX = 1,
  /* Downlink logical address index */
  LA_DOWNLINK_IDX = 2,
};

enum {
  /* Uplink logical address index */
  LA_UPLINK = 0x5D,
  /* Downlink logical address index */
  LA_DOWNLINK = 0xF7,
};

/* Used to signal from the radio ISR to the handler thread */
enum {
  RADIO_EVT_CRCOK = (1UL << 0),
  RADIO_EVT_CLAIM = (1UL << 1),
  RADIO_EVT_END = (1UL << 2),
};

K_EVENT_DEFINE(radio_evt);

ISR_DIRECT_DECLARE(radio_isr) {
  if ((NRF_RADIO->EVENTS_TXREADY == 1) && (NRF_RADIO->INTENSET & RADIO_INTENSET_TXREADY_Msk)) {
    NRF_RADIO->EVENTS_TXREADY = 0;

    /* Set shorts for turning around to RX */
    NRF_RADIO->SHORTS &= ~RADIO_SHORTS_DISABLED_TXEN_Msk;
    NRF_RADIO->SHORTS |= RADIO_SHORTS_DISABLED_RXEN_Msk;

    NRF_RADIO->INTENCLR = 0xFFFFFFFF;
    NRF_RADIO->INTENSET = RADIO_INTENSET_END_Msk;
  }
  if ((NRF_RADIO->EVENTS_RXREADY == 1) && (NRF_RADIO->INTENSET & RADIO_INTENSET_RXREADY_Msk)) {
    NRF_RADIO->EVENTS_RXREADY = 0;

    /* Set shorts for turning around to TX to send acknowledgement */
    NRF_RADIO->SHORTS &= ~RADIO_SHORTS_DISABLED_RXEN_Msk;
    NRF_RADIO->SHORTS |= RADIO_SHORTS_DISABLED_TXEN_Msk;
    NRF_RADIO->INTENCLR = 0xFFFFFFFF;
    NRF_RADIO->INTENSET = RADIO_INTENSET_CRCOK_Msk | RADIO_INTENSET_CRCERROR_Msk;
  }
  /* Transmission of acknowledgement has finished */
  if ((NRF_RADIO->EVENTS_END == 1) && (NRF_RADIO->INTENSET & RADIO_INTENSET_END_Msk)) {
    NRF_RADIO->EVENTS_END = 0;

    /* Prepare for listening again */
    NRF_RADIO->PACKETPTR = (uint32_t)&rx_pkt;
    NRF_RADIO->INTENCLR = 0xFFFFFFFF;
    NRF_RADIO->INTENSET = RADIO_INTENSET_RXREADY_Msk;

    /* Notify application that the acknowledgement has been sent */
    k_event_post(&radio_evt, RADIO_EVT_END);
    /* Ask the scheduler to do its job */
    return 1;
  }
  /* Valid packet received */
  if ((NRF_RADIO->EVENTS_CRCOK == 1) && (NRF_RADIO->INTENSET & RADIO_INTENSET_CRCOK_Msk)) {
    NRF_RADIO->EVENTS_CRCOK = 0;

    pkt_t* tx_pkt;
    /* Get a packet that is to be sent to the device from which we just received something */
    if (msg_buf_get_claim(&tx_pkt, rx_pkt.hdr.dev_id) == 0)
      /* Let the application know that we have claimed a buffer */
      k_event_post(&radio_evt, RADIO_EVT_CLAIM);
    else {
      /* If there is no packet pending, send an empty acknowledgement */
      tx_pkt = &ack_only_pkt;
      /* Acknowledgements always have the same device ID as the acknowledged packet */
      tx_pkt->hdr.dev_id = rx_pkt.hdr.dev_id;
    }

    /* Insert Packet ID of received packet into acknowledgement */
    tx_pkt->hdr.ack_id = rx_pkt.hdr.pkt_id;
    /* Insert destination ID into acknowledgement */
    tx_pkt->hdr.dev_id = rx_pkt.hdr.dev_id;

    NRF_RADIO->PACKETPTR = (uint32_t)tx_pkt;

    NRF_RADIO->INTENCLR = 0xFFFFFFFF;
    NRF_RADIO->INTENSET = RADIO_INTENSET_TXREADY_Msk;

    /* Notify application that it can pick up the received packet */
    k_event_post(&radio_evt, RADIO_EVT_CRCOK);
    /* Ask the scheduler to do its job */
    return 1;
  }
  /* Bad CRC -> Abort transmission of Acknowledgement*/
  if ((NRF_RADIO->EVENTS_CRCERROR == 1) && (NRF_RADIO->INTENSET & RADIO_INTENSET_CRCERROR_Msk)) {
    NRF_RADIO->EVENTS_CRCERROR = 0;

    /* Set shorts for turning around to RX */
    NRF_RADIO->SHORTS &= ~RADIO_SHORTS_DISABLED_TXEN_Msk;
    NRF_RADIO->SHORTS |= RADIO_SHORTS_DISABLED_RXEN_Msk;

    /* Disable radio to start listening again */
    NRF_RADIO->TASKS_DISABLE = 1;

    NRF_RADIO->INTENCLR = 0xFFFFFFFF;
    NRF_RADIO->INTENSET = RADIO_INTENSET_RXREADY_Msk;
  }
  return 0;
}

int radio_init() {
  /* 0dBm TX power */
  NRF_RADIO->TXPOWER = (RADIO_TXPOWER_TXPOWER_0dBm << RADIO_TXPOWER_TXPOWER_Pos);
  /* 2450 MHz frequency */
  NRF_RADIO->FREQUENCY = 76UL;
  /* BLE 2MBit */
  NRF_RADIO->MODE = (RADIO_MODE_MODE_Ble_1Mbit << RADIO_MODE_MODE_Pos);
  /* Fast radio rampup */
  NRF_RADIO->MODECNF0 = (RADIO_MODECNF0_RU_Fast << RADIO_MODECNF0_RU_Pos);

  /* We'll only use base address 1, i.e. logical addresses 1-7 */
  NRF_RADIO->BASE1 = 0xFB235D41;

  NRF_RADIO->PREFIX0 = (LA_DOWNLINK << 16) | (LA_UPLINK << 8);
  /* We want to receive on both, downlink and uplink message addresses */
  NRF_RADIO->RXADDRESSES = (1UL << LA_UPLINK_IDX);

  /* Make interframe spacing slightly longer than turnaround time (~40us) */
  NRF_RADIO->TIFS = 60;

  /* No S0, LEN and S1 fields */
  NRF_RADIO->PCNF0 = (0 << RADIO_PCNF0_S1LEN_Pos) | (0 << RADIO_PCNF0_S0LEN_Pos) | (8 << RADIO_PCNF0_LFLEN_Pos) |
                     (RADIO_PCNF0_PLEN_8bit << RADIO_PCNF0_PLEN_Pos);

  /* No whitening, little endian, 2B base address, 4B payload */
  NRF_RADIO->PCNF1 = (RADIO_PCNF1_WHITEEN_Disabled << RADIO_PCNF1_WHITEEN_Pos) |
                     (RADIO_PCNF1_ENDIAN_Little << RADIO_PCNF1_ENDIAN_Pos) | (2 << RADIO_PCNF1_BALEN_Pos) |
                     (0 << RADIO_PCNF1_STATLEN_Pos) | (255 << RADIO_PCNF1_MAXLEN_Pos);

  /* One byte CRC */
  NRF_RADIO->CRCCNF = (RADIO_CRCCNF_LEN_Three << RADIO_CRCCNF_LEN_Pos);
  NRF_RADIO->CRCINIT = 0xABUL;
  NRF_RADIO->CRCPOLY = 0x108UL;

  NRF_RADIO->TXADDRESS = LA_DOWNLINK_IDX;

  /* Set default shorts */
  NRF_RADIO->SHORTS = RADIO_SHORTS_READY_START_Msk | RADIO_SHORTS_END_DISABLE_Msk;

  NRF_RADIO->INTENCLR = 0xFFFFFFFF;

  IRQ_DIRECT_CONNECT(RADIO_IRQn, 0, radio_isr, 0);
  irq_enable(RADIO_IRQn);

  /* Prepare empty acknowledgement packet */
  ack_only_pkt.len = sizeof(pkt_header_t);
  ack_only_pkt.hdr.pkt_id = 0xFFFF;

  return 0;
}

/* This thread processes the radio events to offload work from the ISR. */
static void radio_handler() {
  pkt_t tmp_buf;
  while (1) {
    /* Wait until a valid packet is received */
    k_event_wait(&radio_evt, RADIO_EVT_CRCOK, false, K_FOREVER);
    /* Copy received packet into buffer to immediately free the receive buffer */
    memcpy(&tmp_buf, &rx_pkt, rx_pkt.len + 1);

    /* Wait until acknowledgement has been sent */
    k_event_wait(&radio_evt, RADIO_EVT_END, false, K_FOREVER);

    /* If the acknowledgement packet has been taken from the message buffer*/
    if (radio_evt.events & RADIO_EVT_CLAIM)
      /* Tell the buffer that we're done with the packet */
      msg_buf_get_finish(tmp_buf.hdr.dev_id);

    /* Send last received packet to application for processing */
    k_msgq_put(&pkt_mq, &tmp_buf, K_NO_WAIT);

    k_event_clear(&radio_evt, 0xFFFFFFFF);
  }
}

int radio_msgq_get(pkt_t* pkt, k_timeout_t timeout) {
  return k_msgq_get(&pkt_mq, pkt, timeout);
}

int radio_start() {
  /* Thread has high priority */
  k_thread_create(&radio_thread_data, radio_thread_stack, K_THREAD_STACK_SIZEOF(radio_thread_stack), radio_handler,
                  NULL, NULL, NULL, 1, 0, K_NO_WAIT);

  /* If it's not running, start the HFCLCK */
  if ((NRF_CLOCK->HFCLKSTAT & (CLOCK_HFCLKSTAT_SRC_Xtal << CLOCK_HFCLKSTAT_SRC_Pos)) == 0) {
    NRF_CLOCK->EVENTS_HFCLKSTARTED = 0;

    NRF_CLOCK->TASKS_HFCLKSTART = 1;

    while (NRF_CLOCK->EVENTS_HFCLKSTARTED == 0) {
    };
    NRF_CLOCK->EVENTS_HFCLKSTARTED = 0;
  }

  NRF_RADIO->PACKETPTR = (uint32_t)&rx_pkt;
  NRF_RADIO->INTENSET = RADIO_INTENSET_RXREADY_Msk;
  NRF_RADIO->TASKS_RXEN = 1;

  return 0;
}
```

## src/radio.h
```c
#ifndef __RADIO_H_
#define __RADIO_H_

int radio_init();
int radio_start();

/* Max payload size is 255. We have 8 Byte protocol overhead. */
#define PKT_PAYLOAD_SIZE (255 - sizeof(pkt_header_t))

typedef struct __attribute__((packed)) {
  /* This is always the ID of the 'station' device sending or receiving the packet */
  uint32_t dev_id;
  /* ID of the packet */
  uint16_t pkt_id;
  /* ID of a previous packet that is acknowledged with this packet */
  uint16_t ack_id;
} pkt_header_t;

typedef struct __attribute__((packed)) {
  /* Lenght of the packet, excluding this one byte length field */
  uint8_t len;
  pkt_header_t hdr;
  /* Max payload size is 255. We have 8 Byte protocol overhead. */
  uint8_t data[PKT_PAYLOAD_SIZE];
} pkt_t;

int radio_msgq_get(pkt_t* pkt, k_timeout_t timeout);

#endif /* __RADIO_H_ */
```
